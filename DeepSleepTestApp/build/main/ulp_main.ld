/* Variable definitions for ESP32ULP linker
 * This file is generated automatically by esp32ulp_mapgen.py utility.
 */

PROVIDE ( ulp_changed = 0x5000003c );
PROVIDE ( ulp_debounce_counter = 0x500000b8 );
PROVIDE ( ulp_debounce_max_count = 0x500000bc );
PROVIDE ( ulp_edge_count = 0x500000c0 );
PROVIDE ( ulp_edge_count_to_wake_up = 0x500000c4 );
PROVIDE ( ulp_edge_detected = 0x50000058 );
PROVIDE ( ulp_entry = 0x50000000 );
PROVIDE ( ulp_io_number = 0x500000c8 );
PROVIDE ( ulp_next_edge = 0x500000b4 );
PROVIDE ( ulp_wake_up = 0x500000a0 );
